## boards/shields/slonik/Kconfig.shield
```kconfig
config SHIELD_SLONIK_LEFT
    def_bool $(shields_list_contains,slonik_left)

config SHIELD_SLONIK_RIGHT
    def_bool $(shields_list_contains,slonik_right)
```

## config/boards/shields/slonik/Kconfig.defconfig
```kconfig
if SHIELD_SLONIK_LEFT

config ZMK_KEYBOARD_NAME
    default "Slonik"

config ZMK_SPLIT_ROLE_CENTRAL
    default y

endif

if SHIELD_SLONIK_LEFT || SHIELD_SLONIK_RIGHT

config ZMK_SPLIT
    default y

endif
```
